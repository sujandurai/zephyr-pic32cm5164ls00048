## boards/microchip/pic32c/pic32cm5164ls00048/Kconfig.pic32cm5164ls00048
```kconfig
# Copyright (c) 2026 Microchip Technology Inc.

# SPDX-License-Identifier: Apache-2.0

config BOARD_PIC32CM5164LS00048
	select SOC_PIC32CM5164LS00048
```

## boards/microchip/pic32c/pic32cm5164ls00048/board.yml
```yaml
# Copyright (c) 2026 Microchip Technology Inc.

# SPDX-License-Identifier: Apache-2.0

board:
  name: pic32cm5164ls00048
  full_name: PIC32CM5164LS00048
  vendor: microchip
  socs:
    - name: pic32cm5164ls00048
```

## drivers/sensor/pir/Kconfig
```kconfig
config PIR
	bool "PIR Motion Sensor"
	default y
	depends on GPIO
	help
	  Enable the PIR motion sensor driver.
```

## dts/bindings/clock/microchip,pic32cm-ls-fdpll.yaml
```yaml
# Copyright (c) 2026 Microchip Technology Inc.
# SPDX-License-Identifier: Apache-2.0

description: Microchip PIC32CM LS00 FDPLL

compatible: "microchip,pic32cm-ls-fdpll"

include: [clock-controller.yaml, base.yaml]

properties:
    "#clock-cells":
      const: 0
```

## soc/microchip/pic32c/pic32cm_ls/Kconfig
```kconfig
# Copyright (c) 2026 Microchip Technology Inc.
# SPDX-License-Identifier: Apache-2.0

config SOC_FAMILY_MICROCHIP_PIC32CM_LS
	bool
	select ARM
	select CPU_CORTEX_M23
	select ARMV8_M_BASELINE
	select CPU_CORTEX_M_HAS_VTOR
	select HAS_SWJ

rsource "Kconfig.soc"
```

## soc/microchip/pic32c/pic32cm_ls/Kconfig.defconfig
```kconfig
# Copyright (c) 2026 Microchip Technology Inc.
# SPDX-License-Identifier: Apache-2.0

if SOC_SERIES_PIC32CM_LS00

config SOC_SERIES
	default "pic32cm_ls00"

config SOC
	default "pic32cm5164ls00048" if SOC_PIC32CM5164LS00048

config SYS_CLOCK_HW_CYCLES_PER_SEC
	default 48000000

config CORTEX_M_SYSTICK
	default y

config SYSTEM_TIMER_HAS_LPM_COMPANION_SUPPORT
	default y

config CORTEX_M_SYSTICK_LPM_TIMER_NONE
	default y

config NUM_IRQS
	default 71

config CPU_HAS_ARM_MPU
	default y

config CPU_HAS_ARM_MPU
	default y

endif # SOC_SERIES_PIC32CM_LS00
```

## soc/microchip/pic32c/pic32cm_ls/Kconfig.soc
```kconfig
# Copyright (c) 2026 Microchip Technology Inc.
# SPDX-License-Identifier: Apache-2.0

config SOC_SERIES_PIC32CM_LS00
	bool
	select SOC_FAMILY_MICROCHIP_PIC32CM_LS
	default y

config NUM_IRQ_PRIO_BITS
        int
	default 2

config SOC_PIC32CM5164LS00048
	bool
	select SOC_SERIES_PIC32CM_LS00
        default y
	help
	  PIC32CM5164LS00048 (512KB Flash, 64KB SRAM, 48-pin)
```

## soc/microchip/pic32c/pic32cm_ls/kconfig.soc
```kconfig
# Copyright (c) 2026 Microchip Technology Inc.

# SPDX-License-Identifier: Apache-2.0

config SOC_FAMILY_MICROCHIP_PIC32CM_LS
	bool

config SOC_FAMILY
	default "microchip_pic32cm_ls" if SOC_FAMILY_MICROCHIP_PIC32CM_LS

rsource "*/Kconfig.soc"
```

## soc/microchip/pic32c/pic32cm_ls/pic32cm_ls00/Kconfig.soc
```kconfig
# Copyright (c) 2026 Microchip Technology Inc.

# SPDX-License-Identifier: Apache-2.0

config SOC_SERIES_PIC32CM_LS00
	bool
	select SOC_FAMILY_MICROCHIP_PIC32CM_LS

	help
	  Enable support for Microchip PIC32CM LS00 Cortex-M23 microcontrollers.

config SOC_SERIES
	default "pic32cm_ls00" if SOC_SERIES_PIC32CM_LS00

config SOC_PIC32CM5164LS00048
	bool
	select SOC_SERIES_PIC32CM_LS00

config SOC
	default "pic32cm5164ls00048" if SOC_PIC32CM5164LS00048
```

## zephyr/boards/microchip/pic32c/pic32cm_ls00_cnano/board.yml
```yaml
# Copyright (c) 2026 Microchip Technology Inc.

# SPDX-License-Identifier: Apache-2.0

board:
  name: pic32cm_ls00_cnano
  full_name: PIC32CM LS00 Curiosity Nano
  vendor: microchip
  socs:
    - name: pic32cm5164ls00048
```

## zephyr/dts/bindings/clock/microchip,pic32cm-ls-clock.yaml
```yaml
# Copyright (c) 2026 Microchip Technology Inc.
# SPDX-License-Identifier: Apache-2.0

description: Microchip PIC32CM LS clock controller

compatible: "microchip,pic32cm-ls-clock"

include: [clock-controller.yaml, base.yaml]

properties:
  reg:
    required: true
  "#clock-cells":
    const: 1

clock-cells:
  - subsystem
```

## zephyr/dts/bindings/clock/microchip,pic32cm-ls-gclkgen.yaml
```yaml
# Copyright (c) 2026 Microchip Technology Inc.
# SPDX-License-Identifier: Apache-2.0

description: Microchip PIC32CM LS00 GCLK generator

compatible: "microchip,pic32cm-ls-gclkgen"

include: [clock-controller.yaml, base.yaml]

properties:
    "#clock-cells":
      const: 1
```

## zephyr/dts/bindings/clock/microchip,pic32cm-ls-gclkperiph.yaml
```yaml
# Copyright (c) 2026 Microchip Technology Inc.
# SPDX-License-Identifier: Apache-2.0

description: Microchip PIC32CM LS00 GCLK peripheral channel

compatible: "microchip,pic32cm-ls-gclkperiph"

include: [clock-controller.yaml, base.yaml]

properties:
    "#clock-cells":
      const: 0
```

## zephyr/dts/bindings/clock/microchip,pic32cm-ls-mclkcpu.yaml
```yaml
# Copyright (c) 2026 Microchip Technology Inc.
# SPDX-License-Identifier: Apache-2.0

description: Microchip PIC32CM LS00 MCLK CPU clock controller

compatible: "microchip,pic32cm-ls-mclkcpu"

include: [clock-controller.yaml, base.yaml]

properties:
    "#clock-cells":
      const: 1
```

## zephyr/dts/bindings/clock/microchip,pic32cm-ls-osc16m.yaml
```yaml
# Copyright (c) 2026 Microchip Technology Inc.
# SPDX-License-Identifier: Apache-2.0

description: Microchip PIC32CM LS00 OSC16M oscillator

compatible: "microchip,pic32cm-ls-osc16m"

include: [clock-controller.yaml, base.yaml]

properties:
    "#clock-cells":
      const: 0
```

## zephyr/dts/bindings/sensor/sujan,pir.yaml
```yaml
description: PIR Motion Sensor

compatible: "sujan,pir"

include: sensor-device.yaml

properties:
  gpios:
    type: phandle-array
    required: true
    description: |
      GPIO pin connected to the PIR sensor output signal.
```

## zephyr/soc/microchip/pic32c/pic32cm_ls/Kconfig
```kconfig
# Copyright (c) 2026 Microchip Technology Inc.
# SPDX-License-Identifier: Apache-2.0

config SOC_FAMILY_MICROCHIP_PIC32CM_LS
	bool
	select ARM
	select MICROCHIP_PIC32C
	select SOC_RESET_HOOK
	select CPU_CORTEX_M23
	select CPU_CORTEX_M_HAS_SYSTICK
	select CPU_CORTEX_M_HAS_VTOR
	select CPU_HAS_ARM_MPU
	select HAS_CMSIS_CORE
	select HAS_SWJ
	select INIT_ARCH_HW_AT_BOOT
	select CLOCK_CONTROL


rsource "Kconfig.soc"
```
