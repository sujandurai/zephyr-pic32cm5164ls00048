## CMakeLists.txt
```
cmake_minimum_required(VERSION 3.20.0)

find_package(Zephyr REQUIRED HINTS $ENV{ZEPHYR_BASE})

project(different_tasks)

target_sources(app PRIVATE
    src/main.c
    src/button.c
)
```

## prj.conf
```kconfig
CONFIG_GPIO=y;
CONFIG_CONSOLE=y
CONFIG_PRINTK=y
```

## button.overlay
```dts
/ {
    gpio_keys {
        compatible = "gpio-keys";

        button: button {
            gpios = <&gpioa 0 GPIO_ACTIVE_HIGH>;
            label = "BUTTON";
        };
    };

    aliases {
        my-input = &button;
    };
};
```

## pir.overlay
```dts
/ {
    gpio_keys {
        compatible = "gpio-keys";

        pir: pir {
            gpios = <&gpioc 13 GPIO_ACTIVE_HIGH>;
            label = "PIR";
        };
    };

    aliases {
        my-input = &pir;
    };
};
```

## src/main.c
```c
#include "button.h"
int main(void)
{
    button_task();

    return 0;
}
```

## src/button.c
```c
#include <zephyr/kernel.h>
#include <zephyr/device.h>
#include <zephyr/drivers/gpio.h>
#include "button.h"

#define GPIOA_NODE DT_NODELABEL(gpioa)

#define BUTTON_PIN 0    /* PA0 - USER Button */
#define LED_PIN    5    /* PA5 - LD2 */

void button_task(void)
{
    const struct device *gpioa = DEVICE_DT_GET(GPIOA_NODE);

    if (!device_is_ready(gpioa)) {
        return;
    }

    gpio_pin_configure(gpioa, BUTTON_PIN, GPIO_INPUT);
    gpio_pin_configure(gpioa, LED_PIN, GPIO_OUTPUT_INACTIVE);

    while (1) {
        int value = gpio_pin_get(gpioa, BUTTON_PIN);

        gpio_pin_set(gpioa, LED_PIN, value);

        k_msleep(100);
    }
}
```

## src/button.h
```c
#ifndef BUTTON_H
#define BUTTON_H

void button_task(void);

#endif
```

## src/gpio.c
```c
#include <zephyr/kernel.h>
#include <zephyr/device.h>
#include <zephyr/drivers/gpio.h>
#include "gpio.h"

#define GPIOA_NODE DT_NODELABEL(gpioa)
#define GPIOC_NODE DT_NODELABEL(gpioc)

#define INPUT_PIN   13    /* PC13 */
#define OUTPUT_PIN   0    /* PA0 */

void gpio_task(void)
{
    const struct device *gpioa = DEVICE_DT_GET(GPIOA_NODE);
    const struct device *gpioc = DEVICE_DT_GET(GPIOC_NODE);

    if (!device_is_ready(gpioa) || !device_is_ready(gpioc)) {
        return;
    }

    gpio_pin_configure(gpioc, INPUT_PIN, GPIO_INPUT);
    gpio_pin_configure(gpioa, OUTPUT_PIN, GPIO_OUTPUT_INACTIVE);

    while (1) {

        int value = gpio_pin_get(gpioc, INPUT_PIN);

        if (value) {
            gpio_pin_set(gpioa, OUTPUT_PIN, 1);
        } else {
            gpio_pin_set(gpioa, OUTPUT_PIN, 0);
        }

        k_msleep(100);
    }
}
```

## src/gpio.h
```c
#ifndef GPIO_H
#define GPIO_H

void gpio_task(void);

#endif
```
