## CMakeLists.txt
```
cmake_minimum_required(VERSION 3.20.0)

find_package(Zephyr REQUIRED HINTS $ENV{ZEPHYR_BASE})
project(Project2)

target_sources(app PRIVATE src/main.c)
```

## prj.conf
```kconfig
CONFIG_GPIO=y;
CONFIG_SENSOR=y;

CONFIG_CONSOLE=y
CONFIG_PRINTK=y
```

## app.overlay
```dts
#include <zephyr/dt-bindings/gpio/gpio.h>

/ {
    led1: user_led1 {
        compatible = "gpio-leds";
        gpios = <&gpioa 6 GPIO_ACTIVE_HIGH>;
        label = "LED1";
    };

    led2: user_led2 {
        compatible = "gpio-leds";
        gpios = <&gpiob 3 GPIO_ACTIVE_HIGH>;
        label = "LED2";
    };
};
        
```

## src/main.c
```c
#include <zephyr/kernel.h>
#include <zephyr/sys/printk.h>

#define STACK_SIZE 1024
#define PRIORITY   5

void task1(void *p1, void *p2, void *p3)
{
    while (1) {
        printk("Task 1: Running every 500 ms\n");
        k_msleep(500);
    }
}

void task2(void *p1, void *p2, void *p3)
{
    while (1) {
        printk("Task 2: Running every 1000 ms\n");
        k_msleep(1000);
    }
}

K_THREAD_DEFINE(task1_id,
                STACK_SIZE,
                task1,
                NULL, NULL, NULL,
                PRIORITY,
                0,
                0);

K_THREAD_DEFINE(task2_id,
                STACK_SIZE,
                task2,
                NULL, NULL, NULL,
                PRIORITY,
                0,
                0);

int main(void)
{
    printk("Zephyr RTOS Thread Example\n");
    return 0;
}
```
